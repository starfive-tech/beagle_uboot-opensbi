## configs/starfive_dubhe_fpga_defconfig
```kconfig
CONFIG_RISCV=y
CONFIG_SYS_MALLOC_LEN=0x6400000
CONFIG_SYS_MALLOC_F_LEN=0x3000
CONFIG_NR_DRAM_BANKS=1
CONFIG_HAS_CUSTOM_SYS_INIT_SP_ADDR=y
CONFIG_CUSTOM_SYS_INIT_SP_ADDR=0x80500000
CONFIG_SF_DEFAULT_SPEED=20000000
CONFIG_DM_GPIO=y
CONFIG_SPL_DM_SPI=y
CONFIG_DEFAULT_DEVICE_TREE="dubhe90_fpga"
CONFIG_SPL=y
CONFIG_SPL_SPI_FLASH_SUPPORT=y
CONFIG_SPL_SPI=y
CONFIG_SYS_LOAD_ADDR=0x84000000
CONFIG_TARGET_STARFIVE_DUBHE_FPGA=y
CONFIG_NR_CPUS=4
CONFIG_ARCH_RV64I=y
CONFIG_RISCV_SMODE=y
CONFIG_FIT=y
CONFIG_SPL_LOAD_FIT_ADDRESS=0x84000000
CONFIG_USE_BOOTARGS=y
CONFIG_BOOTARGS="console=ttySIF0,115200 earlycon=sbi ip=:::255.255.255.0::eth0:dhcp"
CONFIG_USE_BOOTCOMMAND=y
CONFIG_DISPLAY_CPUINFO=y
CONFIG_DISPLAY_BOARDINFO=y
CONFIG_DISPLAY_BOARDINFO_LATE=y
CONFIG_SPL_MAX_SIZE=0x00200000
CONFIG_SPL_BSS_START_ADDR=0x80300000
CONFIG_SPL_BSS_MAX_SIZE=0x00100000
CONFIG_SYS_SPL_MALLOC=y
CONFIG_HAS_CUSTOM_SPL_MALLOC_START=y
CONFIG_CUSTOM_SYS_SPL_MALLOC_ADDR=0x80700000
CONFIG_SYS_SPL_MALLOC_SIZE=0x00100000
CONFIG_SPL_DM_SPI_FLASH=y
CONFIG_SPL_RAM_SUPPORT=y
CONFIG_SPL_RAM_DEVICE=y
CONFIG_SPL_SPI_LOAD=y
CONFIG_SYS_SPI_U_BOOT_OFFS=0x42000
CONFIG_SYS_BOOTM_LEN=0x04000000
CONFIG_CMD_MMC=y
CONFIG_CMD_MTD=y
CONFIG_CMD_DHCP=y
CONFIG_CMD_MII=y
CONFIG_CMD_PING=y
CONFIG_CMD_EXT4=y
CONFIG_CMD_EXT4_WRITE=y
CONFIG_CMD_FAT=y
CONFIG_CMD_MTDPARTS=y
CONFIG_OF_LIVE=y
CONFIG_OF_LIST="dubhe90_fpga dubhe80_fpga dubhe70_fpga"
CONFIG_SYS_RELOC_GD_ENV_ADDR=y
CONFIG_NET_RANDOM_ETHADDR=y
# CONFIG_OFNODE_MULTI_TREE is not set
CONFIG_SPL_CLK=y
CONFIG_MMC=y
CONFIG_MMC_SPI=y
CONFIG_SUPPORT_EMMC_BOOT=y
CONFIG_DM_MTD=y
CONFIG_SF_DEFAULT_BUS=1
CONFIG_SPI_FLASH_BAR=y
CONFIG_SPI_FLASH_GIGADEVICE=y
CONFIG_SPI_FLASH_ISSI=y
CONFIG_SPI_FLASH_MACRONIX=y
CONFIG_SPI_FLASH_SPANSION=y
CONFIG_SPI_FLASH_STMICRO=y
CONFIG_SPI_FLASH_WINBOND=y
CONFIG_SPI_FLASH_MTD=y
CONFIG_PHY_MARVELL=y
CONFIG_DWC_ETH_QOS=y
CONFIG_DWC_ETH_QOS_STARFIVE=y
CONFIG_RGMII=y
CONFIG_RAM=y
CONFIG_SPL_RAM=y
CONFIG_SPI=y
CONFIG_SPI_SIFIVE=y
```
